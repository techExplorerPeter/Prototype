## SW/BSW/S32DS/Kconfig
```kconfig
menu "S32DS Configuration"
config BSW_S32DS_GEN_CFG
    bool "Do a full check of the FIT before using it"
    default y
    help
        config bsw s32ds generate function
endmenu
```

## SW/Cobblestone/CoreIntergration/Kconfig
```kconfig
menu "Cobblestone CoreIntergration Configuration"
config COREINTERGRATION_CFG
    bool "Do a full check of the FIT before using it"
    default y
    help
        config Cobblestone CoreIntergration function
endmenu
```

## SW/Cobblestone/Kconfig
```kconfig
mainmenu "Cobblestone Configuration Menu"
menu "Cobblestone Configuration"

source "Cobblestone/CoreIntergration/Kconfig"
source "Cobblestone/Middleware/Kconfig"
source "Cobblestone/QM/Kconfig"
source "Cobblestone/RTE/Kconfig"

endmenu
```

## SW/Cobblestone/Middleware/Kconfig
```kconfig
menu "Middleware Configuration"
config MIDDLEWARE_CFG
    bool "Do a full check of the FIT before using it"
    default y
    help
        config Cobblestone Middleware function
endmenu
```

## SW/Cobblestone/QM/Kconfig
```kconfig
menu "QM Configuration"
config QM_CFG
    bool "Do a full check of the FIT before using it"
    default y
    help
        config Cobblestone QM function
endmenu
```

## SW/Cobblestone/RTE/Kconfig
```kconfig
menu "RTE Configuration"
config RTE_CFG
    bool "Do a full check of the FIT before using it"
    default y
    help
        config Cobblestone RTE function
endmenu
```

## SW/Kconfig
```kconfig
mainmenu "Radar M7 Project Configuration Menu"
menu "Radar M7 Project Configuration"

source "BSW/Kconfig"
source "Cobblestone/Kconfig"
source "OEM/Kconfig"

endmenu
```
